## OS_PROJECT_1/configs/kernel_defconfig
```kconfig
CONFIG_SYSVIPC=y
CONFIG_POSIX_MQUEUE=y
CONFIG_NO_HZ_IDLE=y
CONFIG_HIGH_RES_TIMERS=y
CONFIG_PREEMPT_VOLUNTARY=y
CONFIG_TASKSTATS=y
CONFIG_MEMCG=y
CONFIG_CPUSETS=y
CONFIG_CGROUP_CPUACCT=y
CONFIG_PROFILING=n
CONFIG_ARCH_VEXPRESS=y
CONFIG_COMPAT=y
CONFIG_ACPI=y
CONFIG_MODULES=y
CONFIG_MODULE_UNLOAD=y
CONFIG_BINFMT_MISC=y

# Memory Management & Hugepages for Tensor Arenas
CONFIG_TRANSPARENT_HUGEPAGE=y
CONFIG_TRANSPARENT_HUGEPAGE_MADVISE=y
CONFIG_SLUB=y

# Networking Stack & VirtIO Net
CONFIG_NET=y
CONFIG_PACKET=y
CONFIG_UNIX=y
CONFIG_INET=y
CONFIG_NETDEVICES=y
CONFIG_VIRTIO_NET=y

# Virtualization & VirtIO Subsystem
CONFIG_PCI=y
CONFIG_PCI_HOST_GENERIC=y
CONFIG_DEVTMPFS=y
CONFIG_DEVTMPFS_MOUNT=y
CONFIG_VIRTIO=y
CONFIG_VIRTIO_PCI=y
CONFIG_VIRTIO_PCI_LEGACY=y
CONFIG_VIRTIO_MMIO=y
CONFIG_VIRTIO_BALLOON=y
CONFIG_VIRTIO_INPUT=y

# Block Storage Drivers
CONFIG_VIRTIO_BLK=y

# Serial Console & TTY
CONFIG_SERIAL_AMBA_PL011=y
CONFIG_SERIAL_AMBA_PL011_CONSOLE=y
CONFIG_VIRTIO_CONSOLE=y

# Random Number Generator & Real-Time Clock
CONFIG_HW_RANDOM=y
CONFIG_HW_RANDOM_VIRTIO=y
CONFIG_RTC_CLASS=y
CONFIG_RTC_DRV_PL031=y

# ARM64 Hardware NEON SIMD & Cryptographic Acceleration
CONFIG_KERNEL_MODE_NEON=y
CONFIG_ARM64_CRYPTO=y
CONFIG_CRYPTO_SHA256_ARM64=y
CONFIG_CRYPTO_AES_ARM64_CE=y

# Filesystems (Read-Only SquashFS + In-Memory OverlayFS + Ext4)
CONFIG_EXT4_FS=y
CONFIG_EXT4_FS_POSIX_ACL=y
CONFIG_EXT4_FS_SECURITY=y
CONFIG_OVERLAY_FS=y
CONFIG_OVERLAY_FS_REDIRECT_DIR=y
CONFIG_OVERLAY_FS_INDEX=y
CONFIG_SQUASHFS=y
CONFIG_SQUASHFS_FILE_DIRECT=y
CONFIG_SQUASHFS_DECOMP_MULTI_PERCPU=y
CONFIG_SQUASHFS_XZ=y
CONFIG_TMPFS=y
CONFIG_TMPFS_POSIX_ACL=y

# Explicit Bloat Exclusions (Strip Unneeded Drivers)
# CONFIG_DRM is not set
# CONFIG_DRM_VIRTIO_GPU is not set
# CONFIG_FB is not set
# CONFIG_ATA is not set
# CONFIG_SCSI is not set
# CONFIG_FUSE_FS is not set
# CONFIG_VIRTIO_FS is not set
# CONFIG_TCG_TPM is not set
# CONFIG_TCG_TIS is not set
# CONFIG_SOUND is not set
# CONFIG_WIRELESS is not set
# CONFIG_BT is not set
# CONFIG_USB_SUPPORT is not set
# CONFIG_DEBUG_KERNEL is not set
# CONFIG_FTRACE is not set
```
